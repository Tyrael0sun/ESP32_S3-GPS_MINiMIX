## sdkconfig.defaults
```kconfig
# Target chip
CONFIG_IDF_TARGET="esp32s3"

# Suppress legacy I2C driver deprecation warning
CONFIG_I2C_SUPPRESS_DEPRECATE_WARN=y

# Flash size configuration - 4MB
CONFIG_ESPTOOLPY_FLASHSIZE_4MB=y

# PSRAM configuration - ESP32-S3FH4R2: 2MB Quad SPI PSRAM @ 3.3V, 80MHz
CONFIG_ESP32S3_SPIRAM_SUPPORT=y
CONFIG_SPIRAM=y
CONFIG_SPIRAM_MODE_QUAD=y
CONFIG_SPIRAM_TYPE_ESPPSRAM16=y
CONFIG_SPIRAM_SPEED_80M=y
CONFIG_SPIRAM_BOOT_INIT=y
CONFIG_SPIRAM_USE_MALLOC=y
CONFIG_SPIRAM_MEMTEST=y
```
